## config/boards/arm/torapa_chan/Kconfig.board
```kconfig
config BOARD_TORAPA_CHAN
    bool "Torapa-chan TPS43 Controller"
    depends on SOC_NRF52840_QIAA
```

## config/boards/arm/torapa_chan/Kconfig.defconfig
```kconfig
if BOARD_TORAPA_CHAN
config BOARD
    default "torapa_chan"
config BT_CTLR
    default BT
if USB_DEVICE_STACK
config USB_NRFX
    default y
endif
endif
```
